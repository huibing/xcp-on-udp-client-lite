ASAP2_VERSION 1 61
/begin PROJECT hello_xcp ""
/begin MODULE hello_xcp "Simulator A2L for XCP on UDP tests"
/begin MOD_COMMON "" DEPOSIT ABSOLUTE BYTE_ORDER MSB_LAST ALIGNMENT_BYTE 1 ALIGNMENT_WORD 2 ALIGNMENT_LONG 4 ALIGNMENT_FLOAT32_IEEE 4 ALIGNMENT_FLOAT64_IEEE 4 /end MOD_COMMON
/* XCP interface description (UDP) */
/begin IF_DATA XCP
 /begin XCP_ON_UDP_IP 0x104 5555 ADDRESS "169.254.144.47" /end XCP_ON_UDP_IP
/end IF_DATA
/* Memory segments (simulator flash) */
/begin MOD_PAR "" NO_OF_INTERFACES 1
 /begin MEMORY_SEGMENT epk "ECU product key" DATA FLASH EXTERN 0x80000000 0x1C -1 -1 -1 -1 -1
  /begin IF_DATA XCP
   /begin SEGMENT 0x0 0x1 0x0 0x0 0x0 /begin CHECKSUM XCP_ADD_44 MAX_BLOCK_SIZE 0xFFFF /end CHECKSUM
    /begin PAGE 0x0 ECU_ACCESS_WITH_XCP_ONLY XCP_READ_ACCESS_WITH_ECU_ONLY XCP_WRITE_ACCESS_WITH_ECU_ONLY /end PAGE
   /end SEGMENT
  /end IF_DATA
 /end MEMORY_SEGMENT
 /begin MEMORY_SEGMENT my_params "Calibration parameters" DATA FLASH EXTERN 0x80010000 0x30 -1 -1 -1 -1 -1
  /begin IF_DATA XCP
   /begin SEGMENT 0x1 0x1 0x0 0x0 0x0 /begin CHECKSUM XCP_ADD_44 MAX_BLOCK_SIZE 0xFFFF /end CHECKSUM
    /begin PAGE 0x0 ECU_ACCESS_WITH_XCP_ONLY XCP_READ_ACCESS_WITH_ECU_ONLY XCP_WRITE_ACCESS_WITH_ECU_ONLY /end PAGE
   /end SEGMENT
  /end IF_DATA
 /end MEMORY_SEGMENT
/end MOD_PAR
/* Conversion methods */
/begin COMPU_METHOD IDENTITY "identity conversion: phys = int" IDENTICAL "%1.0" "" /end COMPU_METHOD
/begin COMPU_METHOD BOOL "boolean conversion (0=false, 1=true)" TAB_VERB "%1.0" "" COMPU_TAB_REF BOOL_VTAB /end COMPU_METHOD
/begin COMPU_METHOD OP_MODE "operation mode conversion (5 states)" TAB_VERB "%1.0" "" COMPU_TAB_REF OP_MODE_VTAB /end COMPU_METHOD
/begin COMPU_METHOD STATE "state conversion (4 states)" TAB_VERB "%1.0" "" COMPU_TAB_REF STATE_VTAB /end COMPU_METHOD
/begin COMPU_VTAB BOOL_VTAB "boolean values" TAB_VERB 2 0 "false" 1 "true" /end COMPU_VTAB
/begin COMPU_VTAB OP_MODE_VTAB "operation mode values" TAB_VERB 5 0 "MODE_OFF" 1 "MODE_ON" 2 "MODE_AUTO" 3 "MODE_MANUAL" 4 "MODE_SAFE" /end COMPU_VTAB
/begin COMPU_VTAB STATE_VTAB "state values" TAB_VERB 4 0 "STATE_INIT" 1 "STATE_RUN" 2 "STATE_SLEEP" 3 "STATE_ERROR" /end COMPU_VTAB
/* Record layouts */
/begin RECORD_LAYOUT U16 FNC_VALUES 1 UWORD ROW_DIR DIRECT /end RECORD_LAYOUT
/begin RECORD_LAYOUT U32 FNC_VALUES 1 ULONG ROW_DIR DIRECT /end RECORD_LAYOUT
/begin RECORD_LAYOUT U8 FNC_VALUES 1 UBYTE ROW_DIR DIRECT /end RECORD_LAYOUT
/begin RECORD_LAYOUT F32 FNC_VALUES 1 FLOAT32_IEEE ROW_DIR DIRECT /end RECORD_LAYOUT
/begin RECORD_LAYOUT Scalar_BOOLEAN FNC_VALUES 1 UBYTE ROW_DIR DIRECT /end RECORD_LAYOUT
/* Characteristics (calibration parameters) */
/begin CHARACTERISTIC my_params.counter_max "maximum counter value" VALUE 0x80010000 U32 0 NO_COMPU_METHOD 0 4294967295 ECU_ADDRESS_EXTENSION 2 /end CHARACTERISTIC
/begin CHARACTERISTIC my_params.counter_on "counter enable switch" VALUE 0x8001002C Scalar_BOOLEAN 0 BOOL 0 1 ECU_ADDRESS_EXTENSION 2 /end CHARACTERISTIC
/begin CHARACTERISTIC my_params.op_mode "operation mode" VALUE 0x80010030 U8 0 OP_MODE 0 4 ECU_ADDRESS_EXTENSION 2 /end CHARACTERISTIC
/begin CHARACTERISTIC my_params.state "state" VALUE 0x80010034 U8 0 STATE 0 3 ECU_ADDRESS_EXTENSION 2 /end CHARACTERISTIC
/begin CHARACTERISTIC my_params.delay "delay" VALUE 0x80010004 U32 0 NO_COMPU_METHOD 0 4294967295 ECU_ADDRESS_EXTENSION 2 /end CHARACTERISTIC
/begin CHARACTERISTIC my_params.array "byte array" VAL_BLK 0x80010008 U8 0 NO_COMPU_METHOD 0 255 ECU_ADDRESS_EXTENSION 2 NUMBER 4 /end CHARACTERISTIC
/begin CHARACTERISTIC my_params.matrix "byte matrix" VAL_BLK 0x8001000C U8 0 NO_COMPU_METHOD 0 255 ECU_ADDRESS_EXTENSION 2 MATRIX_DIM 4 8 /end CHARACTERISTIC
/begin CHARACTERISTIC my_params.curve "u16 curve" CURVE 0x80010050 U16 0 NO_COMPU_METHOD 0 65535 ECU_ADDRESS_EXTENSION 2
 /begin AXIS_DESCR FIX_AXIS x_axis NO_COMPU_METHOD 10 0 1000 FIX_AXIS_PAR_DIST 0 100 10 /end AXIS_DESCR
/end CHARACTERISTIC
/begin CHARACTERISTIC my_params.map "f32 map" MAP 0x80010060 F32 0 NO_COMPU_METHOD -1e30 1e30 ECU_ADDRESS_EXTENSION 2
 /begin AXIS_DESCR FIX_AXIS y_axis NO_COMPU_METHOD 3 0 300 FIX_AXIS_PAR_DIST 0 100 3 /end AXIS_DESCR
 /begin AXIS_DESCR FIX_AXIS x_axis NO_COMPU_METHOD 9 0 900 FIX_AXIS_PAR_DIST 0 100 9 /end AXIS_DESCR
/end CHARACTERISTIC
/* Measurements */
/begin MEASUREMENT counter "counter measurement" ULONG NO_COMPU_METHOD 0 0 0 4294967295 ECU_ADDRESS 0xFFF8 ECU_ADDRESS_EXTENSION 2 READ_WRITE /end MEASUREMENT
/begin MEASUREMENT const_data "constant data measurement" ULONG NO_COMPU_METHOD 0 0 0 4294967295 ECU_ADDRESS 0xFFFC ECU_ADDRESS_EXTENSION 2 READ_WRITE /end MEASUREMENT
/end MODULE
/end PROJECT
