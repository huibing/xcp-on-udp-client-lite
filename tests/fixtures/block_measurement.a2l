ASAP2_VERSION 1 71
/begin PROJECT block ""
/begin MODULE M ""
/begin MEASUREMENT counter "" ULONG NO_COMPU_METHOD 0 0 0 4294967295 ECU_ADDRESS 0xFFF0 ECU_ADDRESS_EXTENSION 2 READ_WRITE /end MEASUREMENT
/begin TYPEDEF_MEASUREMENT u16_elem "" UWORD NO_COMPU_METHOD 0 0 0 65535 /end TYPEDEF_MEASUREMENT
/begin TYPEDEF_STRUCTURE Block "" 16 /begin STRUCTURE_COMPONENT dtc u16_elem 0 MATRIX_DIM 3 /end STRUCTURE_COMPONENT /begin STRUCTURE_COMPONENT grid u16_elem 6 MATRIX_DIM 2 2 /end STRUCTURE_COMPONENT /begin STRUCTURE_COMPONENT state u16_elem 14 /end STRUCTURE_COMPONENT /end TYPEDEF_STRUCTURE
/begin INSTANCE block "" Block 0x1000 ECU_ADDRESS_EXTENSION 2 /end INSTANCE
/end MODULE
/end PROJECT
