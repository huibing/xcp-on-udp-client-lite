ASAP2_VERSION 1 71
/begin PROJECT structural ""
/begin MODULE M ""
/begin MEASUREMENT counter "" ULONG NO_COMPU_METHOD 0 0 0 4294967295 ECU_ADDRESS 0xFFF0 ECU_ADDRESS_EXTENSION 2 READ_WRITE /end MEASUREMENT
/begin TYPEDEF_MEASUREMENT input "" FLOAT32_IEEE NO_COMPU_METHOD 0 0 -1e30 1e30 /end TYPEDEF_MEASUREMENT
/begin TYPEDEF_MEASUREMENT output_linear "" FLOAT32_IEEE NO_COMPU_METHOD 0 0 -1e30 1e30 /end TYPEDEF_MEASUREMENT
/begin TYPEDEF_MEASUREMENT output_spline "" FLOAT32_IEEE NO_COMPU_METHOD 0 0 -1e30 1e30 /end TYPEDEF_MEASUREMENT
/begin TYPEDEF_STRUCTURE Lookup "" 12 /begin STRUCTURE_COMPONENT input input 0 /end STRUCTURE_COMPONENT /begin STRUCTURE_COMPONENT output_linear output_linear 4 /end STRUCTURE_COMPONENT /begin STRUCTURE_COMPONENT output_spline output_spline 8 /end STRUCTURE_COMPONENT /end TYPEDEF_STRUCTURE
/begin INSTANCE lookup "" Lookup 0xFFF4 ECU_ADDRESS_EXTENSION 2 /end INSTANCE
/end MODULE
/end PROJECT
